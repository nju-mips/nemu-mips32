## Kconfig
```kconfig
mainmenu "This is a configure for nemu-mips32"

choice
  prompt "Machine selection"
  default MARCH_MIPS32_R1

config MARCH_BENCH
  bool "optimized for microbench"
  select NEMU_TRAP
  select XLNX_ULITE
  select NEMU_CLOCK
  select BRAM
  select DDR
  select NEMU_VGA_CTRL
  select MMU_CACHE
  select DECODE_CACHE

config MARCH_MIPS32_R1
  bool "mips32 release 1"
  select DELAYSLOT
  select EXCEPTION
  select PAGING
  select INTR
  select NEMU_TRAP
  select XLNX_ULITE
  select BRAM
  select DDR

config MARCH_NOOP
  bool "noop (no intr)"
  select DELAYSLOT
  select EXCEPTION
  select PAGING
  select NEMU_TRAP
  select XLNX_ULITE
  select BRAM
  select DDR

endchoice

menu "NEMU-MIPS32 features"
if ! MARCH_BENCH
config DELAYSLOT
  bool "Delayslot support"

config SEGMENT
  bool "Segment mode support"

config PAGING
  bool "Paging mode support"

config INTR
  bool "Interrupt support"
  depends on !MARCH_NOOP

config EXCEPTION
  bool "Exception support"
endif

config CMDLINE_ADDR
  hex "The cmdline address"
  default 0xbfc10000

config MMU_CACHE
  bool "Cache mmu results"

config DECODE_CACHE
  bool "Cache decode results"
endmenu

if ! MARCH_BENCH
menu "NEMU-MIPS32 debug options"

config MMU_CACHE_PERF
  bool "Profile mmu cache hit rate"
  default n

config DECODE_CACHE_PERF
  bool "Profile decode cache hit rate"
  default n

config ELF_PERF
  bool "Profilling the executed elf file"
  default n

choice
  prompt "Profiling selection"
  depends on ELF_PERF

config ELF_PERF_TIME
  bool "Profilling time the executed elf file"

config ELF_PERF_INSTR
  bool "Profilling instrs the executed elf file"
endchoice

config DIFF_WITH_QEMU
  bool "Diff test with qemu"
  depends on MARCH_NOOP

config INSTR_LOG
  bool "Log all executed instructions"
  default n

config FUNCTION_TRACE_LOG
  bool "Log function trace"
  default n

config BACKTRACE_LOG
  bool "Log all functions in current stack frame"
  depends on FUNCTION_TRACE_LOG=y

config MMIO_ACCESS_LOG
  bool "log read and write of mmio"
  default n

config MMIO_ACCESS_LOG_DEVICE
  string "device to be logged"
  depends on MMIO_ACCESS_LOG=y
  default "xilinx-spi"

config MMU_CACHE_CHECK
  bool "Check the validness of mmu cache"

config DECODE_CACHE_CHECK
  bool "Check the validness of decode cache"

endmenu
endif

menu "Kernel debug options"
config CAE_CHECK
  bool "Check general registers after eret"

config KERNEL_DEBUG_SERIAL
  bool "Kernel debug serial (cpr $7, 1)"
  depends on KERNEL_ELF_PATH != ""

config CHECK_IMAGE
  bool "Check the consistence of kernel image"

config WARN_PC_EQUALS_ZERO
  bool "Warning when PC is zero"

config DUMP_SYSCALL
  bool "Dump syscalls (posix)"

endmenu

menu "Device simulation"

config GRAPHICS
  bool "enable window (by SDL)"
  default n

menuconfig BRAM
  bool "Block RAM (1 MB)"

config BRAM_BASE
  hex "address of block RAM"
  range 0x00000000 0x20000000
  depends on BRAM=y
  default 0x1fc00000

menuconfig DDR
  bool "DDR (128 MB, main memory)"

config DDR_BASE
  hex "address of DDR"
  range 0x00000000 0x20000000
  depends on DDR=y
  default 0x00000000

menuconfig NEMU_TRAP
  bool "nemu trap"

config NEMU_TRAP_BASE
  hex "address of nemu trap"
  range 0x00000000 0x20000000
  depends on NEMU_TRAP=y
  default 0x10000000

menuconfig NEMU_KEYBOARD
  bool "nemu keyboard"

config NEMU_KEYBOARD_BASE
  hex "address of nemu keyboard"
  range 0x00000000 0x20000000
  depends on NEMU_KEYBOARD=y
  default 0x1fe94000

menuconfig NEMU_PMU
  bool "nemu pmu (for compatibility)"

config NEMU_PMU_BASE
  hex "address of nemu pmu"
  range 0x00000000 0x20000000
  depends on NEMU_PMU=y
  default 0x1fe95000

menuconfig NEMU_CLOCK
  bool "nemu clock"

config NEMU_CLOCK_BASE
  hex "address of nemu clock"
  range 0x00000000 0x20000000
  depends on NEMU_CLOCK=y
  default 0x10002000

menuconfig NEMU_VGA
  bool "nemu vga"
  depends on GRAPHICS=y
  select NEMU_VGA_CTRL

config NEMU_VGA_BASE
  hex "address of nemu vga"
  range 0x00000000 0x20000000
  depends on NEMU_VGA=y
  default 0x10400000

config NEMU_VGA_CTRL
  bool "nemu vga controller"
  depends on NEMU_VGA=y

config NEMU_VGA_CTRL_BASE
  hex "address of nemu vga controller"
  range 0x00000000 0x20000000
  depends on NEMU_VGA_CTRL=y
  default 0x10003000

config NEMU_DISK
  bool "nemu disk controller"

config NEMU_DISK_BASE
  hex "base addr of nemu disk controller"
  default 0x1fe97000

menuconfig XLNX_ULITE
  bool "Xilinx Uartlite device"

config XLNX_ULITE_BASE
  hex "address of uartlite"
  range 0x00000000 0x20000000
  depends on XLNX_ULITE=y
  default 0x1fe50000

menuconfig XLNX_SPI
  bool "Xilinx spi device"

config XLNX_SPI_BASE
  hex "address of spi"
  range 0x00000000 0x20000000
  depends on XLNX_SPI=y
  default 0x1fe80000

menuconfig NETWORK
  bool "network simulation"

config XLNX_ELITE
  bool "xilinx etherlite"
  depends on NETWORK

config XLNX_ELITE_BASE
  hex "address of xilinx etherlite"
  range 0x00000000 0x20000000
  depends on XLNX_ELITE=y
  default 0x1ff00000


endmenu
```
